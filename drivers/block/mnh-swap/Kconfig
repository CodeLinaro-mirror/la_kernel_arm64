## drivers/block/mnh-swap/Kconfig
```kconfig
config MNH_SWAP
        tristate "MNH Swap partition for hibernation support using PCIe outbound region"        
	default n
        ---help---
	    This block driver is used to read and write data to the PCIe outbound region.
```
